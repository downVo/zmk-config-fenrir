## config/boards/shields/fenris/Kconfig.shield
```kconfig
config SHIELD_FENRIR_LEFT
    def_bool $(shields_list_contains,fenrir_left)

config SHIELD_FENRIR_RIGHT
    def_bool $(shields_list_contains,fenrir_right)
```
