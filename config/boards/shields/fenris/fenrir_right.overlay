#include "fenrir.dtsi"

&default_transform { 
    col-offset = <6>;
};

&kscan0 {
    col-gpios
        = <&pro_micro 2 GPIO_ACTIVE_HIGH>  // col 1 in the schematic
        , <&pro_micro 4 GPIO_ACTIVE_HIGH>  // col 2 in the schematic
        , <&pro_micro 10 GPIO_ACTIVE_HIGH> // col 3 in the schematic
        , <&pro_micro 16 GPIO_ACTIVE_HIGH> // col 4 in the schematic
        , <&pro_micro 21 GPIO_ACTIVE_HIGH> // col 5 in the schematic
        , <&pro_micro 19 GPIO_ACTIVE_HIGH> // col 6 in the schematic
        ;
};
