#include "fenrir.dtsi" 


&kscan0 {
    col-gpios
        = <&pro_micro 2 GPIO_ACTIVE_HIGH>  // col 1 in the schematic
        , <&pro_micro 3 GPIO_ACTIVE_HIGH>  // col 2 in the schematic
        , <&pro_micro 4 GPIO_ACTIVE_HIGH>  // col 3 in the schematic
        , <&pro_micro 5 GPIO_ACTIVE_HIGH>  // col 4 in the schematic
        , <&pro_micro 6 GPIO_ACTIVE_HIGH>  // col 5 in the schematic
        , <&pro_micro 7 GPIO_ACTIVE_HIGH>  // col 6 in the schematic
        ;
};
